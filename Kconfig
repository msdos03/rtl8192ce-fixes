## Kconfig
```kconfig
config 8192CE
	tristate "Realtek 8192C PCI WiFi"
	depends on WLAN && PCI
	depends on m
	select WIRELESS_EXT
	select WEXT_PRIV
	help
	If you know the usage of this driver and want to get a stable one, select it.
```
